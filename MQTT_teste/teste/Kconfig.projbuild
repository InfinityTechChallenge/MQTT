## MQTT_teste/teste/Kconfig.projbuild
```kconfig
menu "Experiment Configuration"

    config WIFI_SSID
        string "apgeovi_5G"
        default "Aniket OP6"
        help
            SSID (network name) for the example to connect to.

    config WIFI_PASSWORD
        string "redeapgeovi72"
        default "12345678"
        help
            WiFi password (WPA or WPA2) for the example to use.

    config BROKER_URL
        string "mqtt://192.168.0.134:1883"
        default "mqtt://192.168.43.19:1883"
        help
            URL of the broker to connect to

    config BROKER_URL_FROM_STDIN
        bool
        default y if BROKER_URL = "FROM_STDIN"

endmenu
```
